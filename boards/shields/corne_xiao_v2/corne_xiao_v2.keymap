// Copyright 2023 Manna Harbour
// https://github.com/manna-harbour/miryoku

#include "../../../miryoku/custom_config.h"
#include "../../../miryoku/mapping/42/xiao_corne.h"
#include "../../../miryoku/miryoku.dtsi"

/ {
  chosen {
    zmk,matrix_transform = &default_transform;
  };
};
